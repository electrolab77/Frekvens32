#include "font6x6.h"

// 6x6 pixel font (characters 0-9, A-Z, punctuation and some symbols)
const uint8_t FONT_6X6[] PROGMEM = {
    // Numbers 0-9
    0x06, 0x1E, 0x33, 0x37, 0x3B, 0x33, 0x1E, // '0'
    0x06, 0xC,  0x1C, 0xC,  0xC,  0xC,  0x1E, // '1' 
    0x06, 0x1E, 0x33, 0x3,  0x1C, 0x30, 0x3F, // '2'
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    0x06, 0x1E, 0x33, 0x33, 0x3F, 0x3,  0x1E,  // '9'

    // Letters A-Z
    0x06, 0x1E, 0x33, 0x33, 0x3F, 0x33, 0x33, // 'A'
    0x06, 0x3E, 0x33, 0x3E, 0x33, 0x33, 0x3E, // 'B'
    0x06, 0x1E, 0x33, 0x30, 0x30, 0x33, 0x1E, // 'C'
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    0x06, 0x3F, 0x7,  0xE,  0x1C, 0x38, 0x3F, // 'Z'
 
    // Special characters
    0x06, 0xC,  0xC,  0xC,  0xC,  0x00, 0xC,  // '!'
    0x06, 0x00, 0xC,  0xC,  0x00, 0xC,  0xC,  // ':'
    0x06, 0x1E, 0x33, 0x6,  0xC,  0x00, 0xC,  // '?'
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    0x06, 0x00, 0x00, 0x00, 0x00, 0x00, 0x00  // ' ' (space)
   
};

// Get the pattern of a character
void Font6x6::getCharPattern(char c, uint8_t pattern[CHAR_HEIGHT]) {
    // Convert to uppercase
    if (c >= 'a' && c <= 'z') {
        c -= 32;
    }

    // Calculation of the index in the font
    int index = 0;
    if (c >= '0' && c <= '9') {
        index = (c - '0') * (CHAR_HEIGHT + 1);
    } else if (c >= 'A' && c <= 'Z') {
        index = (10 + (c - 'A')) * (CHAR_HEIGHT + 1);
    } else if (c == ':') {
        index = 36 * (CHAR_HEIGHT + 1);
    } else if (c == '!') {
        index = 37 * (CHAR_HEIGHT + 1);
    } else if (c == '?') {
        index = 38 * (CHAR_HEIGHT + 1);
    } else if (c == '.') {
        index = 39 * (CHAR_HEIGHT + 1);
    } else if (c == '(') {
        index = 40 * (CHAR_HEIGHT + 1);
    } else if (c == ')') {
        index = 41 * (CHAR_HEIGHT + 1);
     } else if (c == '/') {
        index = 42 * (CHAR_HEIGHT + 1);
    } else if (c == '\\') {
        index = 43 * (CHAR_HEIGHT + 1);
    } else { // Space or unknown character
        index = 44 * (CHAR_HEIGHT + 1);
    }

    // Reading the pattern from the PROGMEM
    index++; // Skip width
    for (uint8_t i = 0; i < CHAR_HEIGHT; i++) {
        pattern[i] = pgm_read_byte(&FONT_6X6[index + i]);
    }
}